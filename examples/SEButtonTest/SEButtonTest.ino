/*
 Пример скетча при работе с кнопками.
 На экран выводятся сообщения о событияк кнопки: 
 изменении - переход из замкнутого состояния в разомкнутое и обратно
 замыкании - переход из разомкнутого в замкнутое состояние
 размыкании - переход из замкнутого в разомкнутое состояние
 длительном замыкании - замыкание более чем 1,2 секунды
 длительном размыкании - размыкание более чем на 1,2 секунды после длительного замыкания
 клике - крарковременном замыкании менее чем на 1,2 секунды
 двойном клике - двойное кратковременное замыкание
 нажатом состоянии кнопки

 Разработал: Быков Виктор Сергеевич
 Дата: 25/08/2022г.
 */

#include <SEButton.h>

SEButton btn; // обявляем переменную типа кнопка

void setup() {
  Serial.begin(9600);
  btn.pin = A5; // Задаем пин для кнопки
  btn.analog_pin=true; // Пин является аналоговым
  pinMode(btn.pin,INPUT); // Обявляем Пин в качестве входа
  digitalWrite(btn.pin,HIGH); // Включаем внутреннюю подтяжку на +
  /*
  Данный юлок можно раскомментировать, если необходимо изменить настройки по умолчанию
  btn.long_push_time=1200; // // Время длительного замыкания входа в млс
  btn.dblclick_pause_time=300; // Максимальное время паузы между 2 нажатиями
  */
  btn.init(); // Инициализация кнопки
}

void loop() 
{
  btn.loop();
  if (btn.OnChange()) // Если изменилось состояние между замкнутым и размокнутым
    Serial.println("OnChange");

  if (btn.OnPress()) // true, если кнопка только что замкнулась
    Serial.println("OnPress");

  if (btn.OnRelease()) // true, если кнопка только что разомкнулась
    Serial.println("OnRelease");

  if (btn.OnLongPress()) // true, если кнопка только что длительно замкнулась
    Serial.println("OnLongPress");

  if (btn.OnLongRelease()) // true, если кнопка только что разомкнулась  
    Serial.println("OnLongRelease");

  if (btn.OnClick()) // true, если наcтупил кратковременный click
    Serial.println("OnClick");

  if (btn.OnDblClick()) // true, если наcтупил двойной click
    Serial.println("OnDblClick");

  /*
  if (btn.Pressed()) // true, если кнопка замкнута
    Serial.println("Pressed");
  */
}